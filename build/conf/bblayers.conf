## build/conf/bblayers.conf
```bitbake
# POKY_BBLAYERS_CONF_VERSION is increased each time build/conf/bblayers.conf
# changes incompatibly
POKY_BBLAYERS_CONF_VERSION = "2"

BBPATH = "${TOPDIR}"
BBFILES ?= ""

BBLAYERS ?= " \
  /home/bot/build_ws/poky/meta \
  /home/bot/build_ws/poky/meta-poky \
  /home/bot/build_ws/layers/meta-openembedded/meta-oe \
  /home/bot/build_ws/layers/meta-browser/meta-chromium \
  /home/bot/build_ws/layers/meta-clang \
  /home/bot/build_ws/rosyocforge/meta-diggerkiosk \
  "
```

## meta-diggerkiosk/conf/distro/digger-distro.conf
```bitbake
DISTRO_NAME = "digger-distro"
DISTRO_VERSION = "1.0"
# Chromium requires OpenGL and X11.
# I like to use systemd, but you don't have to.
DISTRO_FEATURES:append = " opengl x11 systemd"
# This disables audio. Feel free to enable it if your device supports it.
DISTRO_FEATURES:remove = "pulseaudio"

# Set systemd as init system
VIRTUAL-RUNTIME_init_manager = "systemd"
VIRTUAL-RUNTIME_initscripts = "systemd-compat-units"

# Build Chromium with kiosk mode enabled.
PACKAGECONFIG:append:pn-chromium-x11 = " kiosk-mode"
```

## meta-diggerkiosk/conf/layer.conf
```bitbake
# We have a conf and classes directory, add to BBPATH
BBPATH .= ":${LAYERDIR}"

# We have recipes-* directories, add to BBFILES
BBFILES += "${LAYERDIR}/recipes-*/*/*.bb \
            ${LAYERDIR}/recipes-*/*/*.bbappend"

BBFILE_COLLECTIONS += "meta-diggerkiosk"
BBFILE_PATTERN_meta-diggerkiosk = "^${LAYERDIR}/"
BBFILE_PRIORITY_meta-diggerkiosk = "6"

LAYERDEPENDS_meta-diggerkiosk = "core"
LAYERSERIES_COMPAT_meta-diggerkiosk = "dunfell"
```
